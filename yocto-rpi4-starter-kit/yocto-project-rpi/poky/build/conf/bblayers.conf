## yocto-rpi4-starter-kit/yocto-project-rpi/poky/build/conf/bblayers.conf
```bitbake
# POKY_BBLAYERS_CONF_VERSION is increased each time build/conf/bblayers.conf
# changes incompatibly
POKY_BBLAYERS_CONF_VERSION = "2"

BBPATH = "${TOPDIR}"
BBFILES ?= ""

BBLAYERS ?= " \
  /home/arda/yocto-project-rpi-2/poky/meta \
  /home/arda/yocto-project-rpi-2/poky/meta-poky \
  /home/arda/yocto-project-rpi-2/poky/meta-yocto-bsp \
  /home/arda/yocto-project-rpi-2/poky/meta-raspberrypi \
  /home/arda/yocto-project-rpi-2/poky/meta-openembedded/meta-oe \
  /home/arda/yocto-project-rpi-2/poky/meta-openembedded/meta-python \
  /home/arda/yocto-project-rpi-2/poky/meta-openembedded/meta-networking \
  /home/arda/yocto-project-rpi-2/poky/meta-openembedded/meta-multimedia \
  "
```
